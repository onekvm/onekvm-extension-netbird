## meta-onekvm-extension-netbird/conf/layer.conf
```bitbake
BBPATH .= ":${LAYERDIR}"
BBFILES += "${LAYERDIR}/recipes-*/*/*.bb ${LAYERDIR}/recipes-*/*/*.bbappend"
BBFILE_COLLECTIONS += "onekvm-extension-netbird"
BBFILE_PATTERN_onekvm-extension-netbird := "^${LAYERDIR}/"
BBFILE_PRIORITY_onekvm-extension-netbird = "8"
LAYERDEPENDS_onekvm-extension-netbird = "core onekvm"
LAYERSERIES_COMPAT_onekvm-extension-netbird = "wrynose"
```
